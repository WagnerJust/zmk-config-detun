## config/boards/shields/detun/Kconfig.shield
```kconfig
config SHIELD_DETUN_LEFT
    def_bool $(shields_list_contains,detun_left)

config SHIELD_DETUN_RIGHT
    def_bool $(shields_list_contains,detun_right)

config SHIELD_DETUN_TEST
    def_bool $(shields_list_contains,detun_test)
```
